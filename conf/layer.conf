## conf/layer.conf
```bitbake
# We have a conf and classes directory, add to BBPATH
BBPATH .= ":${LAYERDIR}"

# We have recipes-* directories, add to BBFILES
BBFILES += "${LAYERDIR}/recipes-*/*/*.bb \
            ${LAYERDIR}/recipes-*/*/*/*.bb \
            ${LAYERDIR}/recipes-*/*/*.bbappend"

BBFILE_COLLECTIONS += "meta-dac"
BBFILE_PATTERN_meta-dac = "^${LAYERDIR}/"
BBFILE_PRIORITY_meta-dac = "6"

LAYERDEPENDS_meta-dac = "core"
LAYERSERIES_COMPAT_meta-dac = "dunfell kirkstone wrynose"

DISTRO_FEATURES:remove = " x11"
DISTRO_FEATURES:remove = " kde"
DISTRO_FEATURES:append = " enable_icrypto_openssl"
DISTRO_FEATURES:append = " cobalt_rialto"

RDK_GIT_PROTOCOL = "https"
CMF_GIT_PROTOCOL = "https"
CMF_GIT_BRANCH = "rdk-next"
CMF_GIT_ROOT = "git://code.rdkcentral.com/r"
CMF_GITHUB_MASTER_BRANCH ?= "master"
CMF_GITHUB_ROOT ?= "git://github.com/rdkcentral"
RDK_RELEASE ?= "6.1"

EXTRA_VERSIONS_PATH ?= "${TMPDIR}/versions"

BBMASK += "/meta-rdk/(?!recipes-common/(telemetry|rbus|breakpad_wrapper|lib_syscall_wrapper|libunpriv|rdk-logger|webconfig-framework))"
BBMASK += "/meta-cmf/(?!recipes-extended|recipes-common|(recipes-support/libparodus))"
BBMASK += "/meta-cmf/recipes-extended/(?!rpcserver)"
BBMASK += "/meta-cmf/recipes-common/(?!webconfig-framework|rdk-logger)"
BBMASK += "/meta-rdk-ext/(?!recipes-devtools|recipes-extended|recipes-multimedia|recipes-support)"
BBMASK += "/meta-rdk-ext/recipes-extended/(?!graphite2|curl-netflix)"
BBMASK += "/meta-rdk-ext/recipes-devtools/(?!dwarfutils)"
BBMASK += "/meta-rdk-ext/recipes-support/(?!linenoise)"
# cobalt-24 needs gstreamer 1.18 inside /meta-rdk-ext/recipes-multimedia/gstreamer
# in other cases we use gstreamer 1.16 in meta-openembedded
BBMASK += "${@bb.utils.contains('DISTRO_FEATURES', 'cobalt-24', '/meta-rdk-ext/recipes-multimedia/(?!gstreamer)', '/meta-rdk-ext/recipes-multimedia/', d)}"
BBMASK += "/meta-filogic/recipes-support/network-hotplug/network-hotplug_%.bbappend"

MACHINEOVERRIDES = ":wrynose"
BBMASK += "/meta-rdk-oss-reference/(?!recipes-devtools|recipes-extended|recipes-multimedia|recipes-support)"
BBMASK += "/meta-rdk-oss-reference/recipes-extended/(?!graphite2)"
BBMASK += "/meta-rdk-oss-reference/recipes-devtools/(?!dwarfutils)"
BBMASK += "/meta-rdk-oss-reference/recipes-support/(?!linenoise)"
BBMASK += "/meta-rdk-oss-reference/recipes-multimedia/alsa/alsa-lib_1.2.6%.bbappend"
BBMASK += "/meta-rdk-oss-reference/recipes-multimedia/libomxil"
BBMASK += "/meta-rdk-oss-reference/recipes-multimedia/libpng/libpng_1.6.3%.bbappend"
BBMASK += "/meta-rdk-oss-reference/recipes-multimedia/vlc/vlc_3.0.17-1.bbappend"
BBMASK += "/meta-filogic/recipes-filter/libnfnetlink/libnfnetlink_1.0.1.bbappend"
```
